## main/Kconfig.projbuild
```kconfig
menu "Gimbal Controller"

config LED_PIN
  int "LED GPIO Pin"
  range 0 40
  default 2
  help
    GPIO Connected to LED. Many of the ESP32 development
    boards have one connected to pin 2.

config BUTTON_PIN
  int "BUTTON GPIO Pin"
  range 0 40
  default 0
  help
    GPIO Connected to a active low button for resetting to factory defaults after a long press. Many of the ESP32 development
    boards have one connected to pin 0.

config WIFI_SSID
  string "WIFI Station/AP SSID"
  default "Gimbal-Controller"
  help
    Name of access point or station that the gimbal controller connects to.

config WIFI_SECRET
  string "WIFI Password"
  default "gimbal"
  help
    Password of access point or station that the gimbal controller connects to.

config WIFI_HOSTNAME
  string "WIFI Station Hostname"
  default "gimbal-controller"
  help
    Hostname to be requested via DHCP

endmenu
```

## sdkconfig.defaults
```kconfig
# Override some defaults so BT stack is enabled
# by default in this example
CONFIG_BT_ENABLED=y
CONFIG_BTDM_CONTROLLER_MODE_BLE_ONLY=y
CONFIG_BTDM_CONTROLLER_MODE_BR_EDR_ONLY=
CONFIG_BTDM_CONTROLLER_MODE_BTDM=
CONFIG_GATTS_ENABLE=
CONFIG_PARTITION_TABLE_CUSTOM=y
CONFIG_PARTITION_TABLE_CUSTOM_FILENAME="partitions.csv"
CONFIG_PARTITION_TABLE_FILENAME="partitions.csv"
CONFIG_ESPTOOLPY_FLASHSIZE_2MB=
CONFIG_ESPTOOLPY_FLASHSIZE_4MB=y
CONFIG_WEBSOCKET_SERVER_MAX_CLIENTS=5
CONFIG_WEBSOCKET_SERVER_QUEUE_SIZE=10
CONFIG_WEBSOCKET_SERVER_QUEUE_TIMEOUT=5
CONFIG_WEBSOCKET_SERVER_TASK_STACK_DEPTH=6000
CONFIG_WEBSOCKET_SERVER_TASK_PRIORITY=5
CONFIG_WEBSOCKET_SERVER_PINNED=
CONFIG_LWIP_MAX_SOCKETS=16
CONFIG_MQTT_PROTOCOL_311=
CONFIG_MQTT_TRANSPORT_SSL=
CONFIG_MQTT_TRANSPORT_WEBSOCKET=
CONFIG_MQTT_USE_CUSTOM_CONFIG=
CONFIG_MQTT_TASK_CORE_SELECTION_ENABLED=
CONFIG_MQTT_CUSTOM_OUTBOX=
```
